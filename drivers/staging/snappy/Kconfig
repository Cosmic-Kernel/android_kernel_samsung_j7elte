## drivers/staging/snappy/Kconfig
```kconfig
config SNAPPY_COMPRESS
	select SNAPPY_DECOMPRESS
	tristate "Google Snappy Compression"

config SNAPPY_DECOMPRESS
	tristate "Google Snappy Decompression"
```
